## lora/send/build/Kconfig/arch/Kconfig
```kconfig
# Load Zephyr Arch Kconfig descriptions.
osource "/home/elisa/zephyrproject/zephyr/arch/rx/Kconfig"
osource "/home/elisa/zephyrproject/zephyr/arch/x86/Kconfig"
osource "/home/elisa/zephyrproject/zephyr/arch/xtensa/Kconfig"
osource "/home/elisa/zephyrproject/zephyr/arch/sparc/Kconfig"
osource "/home/elisa/zephyrproject/zephyr/arch/riscv/Kconfig"
osource "/home/elisa/zephyrproject/zephyr/arch/posix/Kconfig"
osource "/home/elisa/zephyrproject/zephyr/arch/mips/Kconfig"
osource "/home/elisa/zephyrproject/zephyr/arch/arm64/Kconfig"
osource "/home/elisa/zephyrproject/zephyr/arch/arm/Kconfig"
osource "/home/elisa/zephyrproject/zephyr/arch/arc/Kconfig"
```

## lorawan_adt7410/build/Kconfig/boards/Kconfig.defconfig
```kconfig
# Load Zephyr board defconfig descriptions.
osource "/home/elisa/zephyrproject/zephyr/boards/st/nucleo_wl55jc/Kconfig.defconfig"
```

## lorawan_adt7410/build/Kconfig/boards/Kconfig.nucleo_wl55jc
```kconfig
# Load board Kconfig descriptions.
osource "/home/elisa/zephyrproject/zephyr/boards/st/nucleo_wl55jc/Kconfig.nucleo_wl55jc"
```

## lorawan_scd41/build/Kconfig/boards/Kconfig
```kconfig
# Load Zephyr board Kconfig descriptions.
osource "/home/elisa/zephyrproject/zephyr/boards/st/nucleo_wl55jc/Kconfig"
```
