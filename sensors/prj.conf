## CMakeLists.txt
```
# SPDX-License-Identifier: Apache-2.0

cmake_minimum_required(VERSION 3.20.0)
find_package(Zephyr REQUIRED HINTS $ENV{ZEPHYR_BASE})
project(gssco2_per_min)

target_sources(app PRIVATE src/maingssco2.c)
```

## prj.conf
```kconfig
CONFIG_GPIO=y
CONFIG_SERIAL=y
CONFIG_UART_INTERRUPT_DRIVEN=y

CONFIG_UART_CONSOLE=y
CONFIG_LOG=y
CONFIG_LOG_PRINTK=y
CONFIG_LOG_BUFFER_SIZE=512
```

## app.overlay
```dts
&usart3 {
	pinctrl-0 = <&usart3_tx_pd8 &usart3_rx_pd9>;
	pinctrl-names = "default";
	current-speed = <9600>;
	status = "okay";
};
```

## src/main_co2_per_min.c
```c
/*
* This Zephyr application configures the USART3 port 
* at 9600 baud, using interrupt-driven reads into a message 
* queue and polling-based writes for sending commands.
* After an initial “K 2” setup, it enters a loop where it 
* sends a “Q” query, waits for a complete line of sensor 
* data from the queue, logs the measurement string, and then 
* sleeps before repeating.
 */

#include <zephyr/kernel.h>
#include <zephyr/device.h>
#include <zephyr/drivers/uart.h>
#include <math.h>


#include <stdio.h>    
#include <string.h>  

#define UART_SENSOR_NODE DT_NODELABEL(usart3)
#define MSG_SIZE 32

K_MSGQ_DEFINE(sensor_msgq, MSG_SIZE, 10, 4);


static const struct device *const uart_sensor = DEVICE_DT_GET(UART_SENSOR_NODE);

/* receive buffer */
static char sensor_rx_buf[MSG_SIZE];
static int sensor_rx_pos;

void sensor_cb(const struct device *dev, void *user_data)
{
	uint8_t c;

	if (!uart_irq_update(uart_sensor)) {
		return;
	}

	if (!uart_irq_rx_ready(uart_sensor)) {
		return;
	}

	/* read until FIFO empty */
	while (uart_fifo_read(uart_sensor, &c, 1) == 1) {
		if ((c == '\n' || c == '\r') && sensor_rx_pos > 0) {
			sensor_rx_buf[sensor_rx_pos] = '\0';

			k_msgq_put(&sensor_msgq, sensor_rx_buf, K_NO_WAIT);

			sensor_rx_pos = 0;
		} else if (sensor_rx_pos < (sizeof(sensor_rx_buf) - 1)) {
			sensor_rx_buf[sensor_rx_pos++] = c;
		}
	}
}


/*
 * Print a null-terminated string character by character to the UART interface
 */
void print_uart(char *buf)
{
	int msg_len = strlen(buf);

	for (int i = 0; i < msg_len; i++) {
		uart_poll_out(uart_sensor, buf[i]);
	}
}

int main(void)
{
	if (!device_is_ready(uart_sensor)) {
		printk("UART device not found!");
		return 0;
	}

	struct uart_config uart_cfg = {
		.baudrate = 9600,
		.parity = UART_CFG_PARITY_NONE,
		.stop_bits = UART_CFG_STOP_BITS_1,
		.data_bits = UART_CFG_DATA_BITS_8,
		.flow_ctrl = UART_CFG_FLOW_CTRL_NONE
	};

	int ret_uart = uart_configure(uart_sensor, &uart_cfg);

	if (ret_uart) {
		printk("ERROR: uart_configure() = %d\n", ret_uart);
		return 0;
	}

	/* configure interrupt and callback to receive data */
	int ret = uart_irq_callback_user_data_set(uart_sensor, sensor_cb, NULL);

	if (ret < 0) {
		if (ret == -ENOTSUP) {
			printk("Interrupt-driven UART API support not enabled\n");
		} else if (ret == -ENOSYS) {
			printk("UART device does not support interrupt-driven API\n");
		} else {
			printk("Error setting UART callback: %d\n", ret);
		}
		return 0;
	}
	uart_irq_rx_enable(uart_sensor);

	char resp[MSG_SIZE];

	print_uart("K 2\r\n");
	k_msleep(500);
	
	while(1){
		print_uart("Q\r\n");

		k_msgq_get(&sensor_msgq, resp, K_FOREVER);
		printk("\nMeasurements per 5 minutes: %s\n", resp);
		k_sleep(K_SECONDS(360));
	}
	
	return 0;
}
```

## src/mainblinkyleds.c
```c
/*
* This Zephyr application configures a GPIO input on the user 
* button with an interrupt callback and three GPIO outputs for LEDs.
* Each time the button is pressed, it debounces briefly, turns 
* all LEDs off, then lights the next LED in a rotating sequence.
*/

#include <zephyr/kernel.h>
#include <zephyr/device.h>
#include <zephyr/drivers/gpio.h>
#include <zephyr/sys/util.h>
#include <zephyr/sys/printk.h>
#include <inttypes.h>

#define SLEEP_TIME_MS 20



#define LED0 DT_ALIAS(led0)
#define LED1 DT_ALIAS(led1)
#define LED2 DT_ALIAS(led2)
#define SW0_NODE DT_ALIAS(sw0)

#if !DT_NODE_HAS_STATUS_OKAY(SW0_NODE)
#error "Unsupported board: sw0 devicetree alias is not defined"
#endif


static struct gpio_dt_spec leds[] = { GPIO_DT_SPEC_GET_OR(LED0, gpios, {0}),
                                      GPIO_DT_SPEC_GET_OR(LED1, gpios, {0}),
                                      GPIO_DT_SPEC_GET_OR(LED2, gpios, {0})
};

#define NUM_LEDS 3


static const struct gpio_dt_spec button = GPIO_DT_SPEC_GET_OR(SW0_NODE, gpios,
							      {0});

static struct gpio_callback button_cb_data;

static bool button_pressed;

void button_pressed_isr(const struct device *dev, struct gpio_callback *cb,
		    uint32_t pins)
{
    button_pressed = true;
}

static int current_led = 0;

int main(void)
{
	int ret;
    int i;

	if (!gpio_is_ready_dt(&button)) {
		printk("Error: button device %s is not ready\n",
		       button.port->name);
		return 0;
	}

	ret = gpio_pin_configure_dt(&button, GPIO_INPUT);
	if (ret != 0) {
		printk("Error %d: failed to configure %s pin %d\n",
		       ret, button.port->name, button.pin);
		return 0;
	}

	ret = gpio_pin_interrupt_configure_dt(&button,
					      GPIO_INT_EDGE_TO_ACTIVE);
	if (ret != 0) {
		printk("Error %d: failed to configure interrupt on %s pin %d\n",
			ret, button.port->name, button.pin);
		return 0;
	}

	gpio_init_callback(&button_cb_data, button_pressed_isr, BIT(button.pin));
	gpio_add_callback(button.port, &button_cb_data);
	printk("Set up button at %s pin %d\n", button.port->name, button.pin);

    for (i = 0; i < NUM_LEDS; i++) {
        if (leds[i].port && !gpio_is_ready_dt(&leds[i])) {
            printk("Error %d: LED %d device %s is not ready; ignoring it\n",
                ret, i + 1, leds[i].port->name);
            leds[i].port = NULL;
            continue;
            }
        
        if (leds[i].port) {
            ret = gpio_pin_configure_dt(&leds[i], GPIO_OUTPUT);
            if (ret != 0) {
                printk("Error %d: failed to configure LED %d device %s pin %d\n",
                    ret, i + 1, leds[i].port->name, leds[i].pin);
                leds[i].port = NULL;
            } else {
                printk("Set up LED %d at %s pin %d\n", i + 1, leds[i].port->name, leds[i].pin);
            }
        }
    }
    printk("Press the button\n");


    while(1){
        if (button_pressed){
            button_pressed = false;
            k_msleep(20);

            for (i = 0; i < NUM_LEDS; i++) {
                if (leds[i].port) {
                    gpio_pin_set_dt(&leds[i], 0);
                }
            }

            if (leds[current_led].port){
                gpio_pin_set_dt(&leds[current_led], 1);
            }
            current_led = (current_led + 1) % NUM_LEDS;
        }
        k_msleep(SLEEP_TIME_MS);
    }
    return 0;
}
```

## src/maingssco2.c
```c
/*
* This Zephyr application configures two UART ports—one 
* for receiving sensor data via interrupts and message queues, 
* and another for sending commands to the sensor.
* It continuously sends commands, reads line-based responses, 
* parses raw temperature, humidity, and CO₂ readings into human-readable 
* values, and logs them.
 */

#include <zephyr/kernel.h>
#include <zephyr/device.h>
#include <zephyr/drivers/uart.h>
#include <math.h>


#include <stdio.h>    
#include <string.h>  

#define UART_SENSOR_NODE DT_NODELABEL(usart3)
#define UART_DEVICE_NODE DT_CHOSEN(zephyr_shell_uart)

#define MSG_SIZE 32

/* queue to store up to 10 messages */
K_MSGQ_DEFINE(uart_msgq, MSG_SIZE, 10, 4);

static const struct device *const uart_dev = DEVICE_DT_GET(UART_DEVICE_NODE);
static const struct device *const uart_sensor = DEVICE_DT_GET(UART_SENSOR_NODE);

/* receive buffer */
static char rx_buf[MSG_SIZE];
static int rx_buf_pos;


/*
 * Read characters from UART until line end is detected and push the
 * data to the message queue.
 */
void serial_cb(const struct device *dev, void *user_data)
{
	uint8_t c;

	if (!uart_irq_update(uart_dev)) {
		return;
	}

	if (!uart_irq_rx_ready(uart_dev)) {
		return;
	}

	/* read until FIFO empty */
	while (uart_fifo_read(uart_dev, &c, 1) == 1) {
		if ((c == '\n' || c == '\r') && rx_buf_pos > 0) {
			rx_buf[rx_buf_pos] = '\0';

			k_msgq_put(&uart_msgq, &rx_buf, K_NO_WAIT);

			rx_buf_pos = 0;
		} else if (rx_buf_pos < (sizeof(rx_buf) - 1)) {
			rx_buf[rx_buf_pos++] = c;
		}
	}
}



/*
 * Print a null-terminated string character by character to the UART interface
 */
void print_uart(char *buf)
{
	int msg_len = strlen(buf);

	for (int i = 0; i < msg_len; i++) {
		uart_poll_out(uart_sensor, buf[i]);
	}
}


int main(void)
{
	if (!device_is_ready(uart_dev) || !device_is_ready(uart_sensor)) {
		printk("UART devices not found!");
		return 0;
	}


	/* configure interrupt and callback to receive data */
	int ret = uart_irq_callback_user_data_set(uart_dev, serial_cb, NULL);

	if (ret < 0) {
		if (ret == -ENOTSUP) {
			printk("Interrupt-driven UART API support not enabled\n");
		} else if (ret == -ENOSYS) {
			printk("UART device does not support interrupt-driven API\n");
		} else {
			printk("Error setting UART callback: %d\n", ret);
		}
		return 0;
	}
	uart_irq_rx_enable(uart_dev);


	printk("Sensor on usart3 starting...\n");

	char cmd[MSG_SIZE];
	char resp[MSG_SIZE];
    uint8_t c;
    int raw;
    int temp, hum, co2;

	print_uart("K 1\r\n");

	while (1) {
		int  idx = 0;
		k_msgq_get(&uart_msgq, &cmd, K_FOREVER);
		printk("In while: cmd = '%s'\n", cmd);
		temp = hum = co2 = 0;

		print_uart(cmd);
		print_uart("\r\n");

		while (1) {
            if (uart_poll_in(uart_sensor, &c) == 0) {
                if ((c == '\n' || c == '\r') && idx > 0) {
                    break;
                }
                if (idx < MSG_SIZE - 1) {
                    resp[idx++] = c;
                }
            }
        }
        resp[idx] = '\0';
        printk("sensor message: '%s'\n", resp);
    

		if (sscanf(resp, "%c %d", &cmd[0], &raw) == 2){
			printk("raw: %d", raw);
			if (cmd[0] == 'T'){
				temp = (raw - 1000) / 10.0;
				printk("Temperature: %dC\n", temp);
			}
			else if (cmd[0] == 'H') {
				hum = raw / 10.0;
				printk("Humidity: %d%%\n", hum);
			}
			else if (cmd[0] == 'Z') {
				co2 = raw * 10.0;
				printk("CO2: %d ppm\n", co2);
			}
			else {
				printk("Unknown command.\n");
			}
		}
	}
	return 0;
}
```
